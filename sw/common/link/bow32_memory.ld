/* AUTO-GENERATED by tools/gen_memmap.py from hw/top/data/bow32_memmap.yaml - DO NOT EDIT */

MEMORY
{
  ROM    (rx) : ORIGIN = 0x00000000, LENGTH = 0x00002000
  FLASH  (rx) : ORIGIN = 0x08000000, LENGTH = 0x00020000
  SRAM   (rwx) : ORIGIN = 0x20000000, LENGTH = 0x00004000
}
